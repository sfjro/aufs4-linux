## fs/aufs/Kconfig
```kconfig
config AUFS_FS
	bool "Aufs (Advanced multi layered unification filesystem) support"
	help
	Aufs is a stackable unification filesystem such as Unionfs,
	which unifies several directories and provides a merged single
	directory.
	In the early days, aufs was entirely re-designed and
	re-implemented Unionfs Version 1.x series. Introducing many
	original ideas, approaches and improvements, it becomes totally
	different from Unionfs while keeping the basic features.

if AUFS_FS
choice
	prompt "Maximum number of branches"
	default AUFS_BRANCH_MAX_127
	help
	Specifies the maximum number of branches (or member directories)
	in a single aufs. The larger value consumes more system
	resources and has a minor impact to performance.
config AUFS_BRANCH_MAX_127
	bool "127"
	help
	Specifies the maximum number of branches (or member directories)
	in a single aufs. The larger value consumes more system
	resources and has a minor impact to performance.
config AUFS_BRANCH_MAX_511
	bool "511"
	help
	Specifies the maximum number of branches (or member directories)
	in a single aufs. The larger value consumes more system
	resources and has a minor impact to performance.
config AUFS_BRANCH_MAX_1023
	bool "1023"
	help
	Specifies the maximum number of branches (or member directories)
	in a single aufs. The larger value consumes more system
	resources and has a minor impact to performance.
config AUFS_BRANCH_MAX_32767
	bool "32767"
	help
	Specifies the maximum number of branches (or member directories)
	in a single aufs. The larger value consumes more system
	resources and has a minor impact to performance.
endchoice

config AUFS_SBILIST
	bool
	depends on PROC_FS
	default y
	help
	Automatic configuration for internal use.
	When aufs supports Magic SysRq or /proc, enabled automatically.

config AUFS_HNOTIFY
	bool "Detect direct branch access (bypassing aufs)"
	help
	If you want to modify files on branches directly, eg. bypassing aufs,
	and want aufs to detect the changes of them fully, then enable this
	option and use 'udba=notify' mount option.
	Currently there is only one available configuration, "fsnotify".
	It will have a negative impact to the performance.
	See detail in aufs.5.

choice
	prompt "method" if AUFS_HNOTIFY
	default AUFS_HFSNOTIFY
config AUFS_HFSNOTIFY
	bool "fsnotify"
	select FSNOTIFY
endchoice

config AUFS_EXPORT
	bool "NFS-exportable aufs"
	depends on EXPORTFS = y
	help
	If you want to export your mounted aufs via NFS, then enable this
	option. There are several requirements for this configuration.
	See detail in aufs.5.

config AUFS_INO_T_64
	bool
	depends on AUFS_EXPORT
	depends on 64BIT && !(ALPHA || S390)
	default y
	help
	Automatic configuration for internal use.
	/* typedef unsigned long/int __kernel_ino_t */
	/* alpha and s390x are int */

config AUFS_RDU
	bool "Readdir in userspace"
	help
	Aufs has two methods to provide a merged view for a directory,
	by a user-space library and by kernel-space natively. The latter
	is always enabled but sometimes large and slow.
	If you enable this option, install the library in aufs2-util
	package, and set some environment variables for your readdir(3),
	then the work will be handled in user-space which generally
	shows better performance in most cases.
	See detail in aufs.5.

config AUFS_DEBUG
	bool "Debug aufs"
	help
	Enable this to compile aufs internal debug code.
	It will have a negative impact to the performance.
endif
```
